/*
Обработчик прерываний, чем меньше адрес/цифра, тем выше приоритет
INT0				Внешнее прерывание 0						1 $0002
INT1				Внешнее прерывание 1						2 $0004
TIMER2				COMP Совпадение таймера/счетчика Т2			3 $0006
TIMER2				OVF Переполнение таймера/счетчика Т2		4 $0008
TIMER1				CAPT Захват таймера/счетчика Т1				5 $000A
TIMER1				COMPA Совпадение «А» таймера/счетчика Т1	6 $000C
TIMER1				COMPB Совпадение «В» таймера/счетчика Т1	7 $000E
TIMER1				OVF Переполнение таймера/счетчика Т1		8 $0010
TIMER0				OVF Переполнение таймера/счетчика Т0		9 $0012
SPI, STC			Передача по SPI завершена					10 $0014
USART, RXC USART,	прием завершен								11 $0016
USART, UDRE			Регистр данных USART пуст					12 $0018
USART, TXC USART,	передача завершена							13 $001A
ADC					Преобразование АЦП завершено				14 $001C
EE_RDY EEPROM,		готово										15 $001E
ANA_COMP			Аналоговый компаратор						16 $0020
TWI					Прерывание от модуля TWI					17 $0022
INT2				Внешнее прерывание 2						18 $0024
TIMER0 COMP			Совпадение таймера/счетчика Т0				19 $0026
SPM_RDY				Готовность SPM								20 $0028
*/

ISR(ADC_vect)
{
	wdt_reset ();
	//=====================	АЦП	8862 Гц ===========================================
		static uint16_t  RR;		
			RR = (ADC);							// Считываем значение из АЦП
				if (RR>VOLT_IN) {OCR1A = 0;}	// Если напряжение выше установленного, то отключаем ШИМ
					else {OCR1A = PWM_LIM;}		// Иначе, включаем ШИМ
	//=====================	Индикация	===================================
		static uint8_t Freq_swich_ind;		// Частота переключения ламп ~300 Гц, ~50 Гц на лампу (при Freq_swich_ind = 30)
			Freq_swich_ind ++;					
				if (Freq_swich_ind >= 30) {Freq_swich_ind = 0; Ind_Lamp ();}  // 30 при 14 мгц Переключение на следующую лампу
	//=====================	Опрос кнопок	===================================			
		static uint8_t Freq_swich_key;		// Частота переключения кнопок ~50 Гц (при Freq_swich_key = 177)	
			Freq_swich_key ++;
				if (Freq_swich_key >= 177) {Freq_swich_key = 0; Swich_key ();}	// 177 при 14 мгц	
	//=====================	Бегуща линия	==========================================
		static	uint16_t Freq_swich_run;		// Частота переключения пикселей
			Freq_swich_run ++;
				if ( Flag_Sec/*Freq_swich_run >= 8862*/) {/*Freq_swich_run = 0;*/Flag_Sec=0; swich_pxl ();}//403 при 14 мгц
	//===================== RGB		=================================
		static uint16_t Freq_RGB;
			Freq_RGB++;
				if (Freq_RGB>=4444) {Flag_RGB =1;}
				
}


ISR	(INT0_vect)				// Обработчик прерываний при нажатии кнопок
{	
	GICR &= ~((1<<INT1)|(1<<INT0));						//	Запрет прерываний от кнопок
		Count_return_setup = 0;							// сбрасываем счетчик возврата
			if (String_button == B2) { Button = Enter;}	// нажат ENTER
				else{Button = Plus;}					// нажат плюс
}

ISR (INT1_vect)				// Обработчик прерываний при нажатии кнопок
{
	GICR &= ~((1<<INT1)|(1<<INT0));					//	Запрет прерываний от кнопок
		Count_return_setup = 0;							//	сбрасываем счетчик возврата
			if (String_button == B1) {Button = Minus;}	// нажат минус
				else {Button = Exit;}					// нажат EXIT
}

ISR (INT2_vect)
{
	GICR	&= 	~((1<<INT2));	//	Запрет прерываний INT2
	Flag_Sec_DS1307 = 1;
	
	//Flag_Sek_DS1307_1 = 1;
	//=====================	 Расчеты - частота формирования прерывания в секунду	============
	//	static uint16_t FQ;
	//	FQ++;
	//	if (Flag_Sek_DS1307_1) {tmp = FQ; FQ =0; Flag_Sek_DS1307_1 = 0;}
}